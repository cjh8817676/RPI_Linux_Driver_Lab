/dts-v1/;
/plugin/;

/ {
    compatible = "brcm,bcm2711";

    fragment@0 {
        target = <&gpio>;
        __overlay__ {
            my_gpio17: my_gpio17 {
                gpios = <17 0>;
                output-low;
            };
        };
    };

    fragment@1 {
        target-path = "/";
        __overlay__ {
            my_gpio_device: my_gpio_device {
                compatible = "my,gpio-device";
                status = "okay";
                gpios = <&gpio 17 0>;
            };
        };
    };
};